
/dts-v1/;
/plugin/;

#include <dt-bindings/gpio/gpio.h>

/ {
    fragment@0 {
        target-path = "/";

        __overlay__ {
            hcsr04 {
                compatible = "techleef,hcsr04";

                trig-gpios = <&gpio 23 GPIO_ACTIVE_HIGH>;
                echo-gpios = <&gpio 24 GPIO_ACTIVE_HIGH>;

                status = "okay";
            };
        };
    };
};
