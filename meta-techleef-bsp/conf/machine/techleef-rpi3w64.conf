## meta-techleef-bsp/wic/techleef-rpi3w64.wks
```
# Techleef Raspberry Pi 3 64-bit A/B OTA image

# Boot partition
part /boot --source bootimg-partition --ondisk mmcblk0 --fstype=vfat --label boot --active --align 4096 --fixed-size 100

# Root filesystem slot A
part / --source rootfs --ondisk mmcblk0 --fstype=ext4 --label rootfsA --align 4096 --fixed-size 256

# Root filesystem slot B
part --source rootfs --ondisk mmcblk0 --fstype=ext4 --label rootfsB --align 4096 --fixed-size 256
```

## meta-techleef-distro/conf/distro/techleef.conf
```bitbake
DISTRO = "techleef"
DISTRO_NAME = "Techleef Embedded Linux"
DISTRO_VERSION = "1.0"
DISTRO_CODENAME = "scarthgap"



INIT_MANAGER = "systemd"
NO_RECOMMENDATIONS = "1"
INHERIT += "cve-check"
# Exclude GPLv3 packages
require conf/distro/include/no-gplv3.inc

# Enable compiler and linker security flags
require conf/distro/include/security_flags.inc

DISTRO_EXTRA_RDEPENDS =""
DISTRO_EXTRA_RRECOMMENDS = ""

DISTRO_FEATURES ="\
ipv4 \
ipv6 \
Ldconfig \
usbgadget \
usbhost \
vfat \
wifi \
"
DISTRO_FEATURES:append = " rauc"
```
